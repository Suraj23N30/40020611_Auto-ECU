/*@!Encoding:1252*/
includes
{
}
variables
{
message 0x300 response={dlc=8};//ID of ECU
byte time[4]={0x00,0x00,0x00,0x00};
int pos_res=0x40;
int neg_res=0x7F;
int NRC[20]={
0x10,//General reject
0x11,//Service not supported
0x12,//Sub function not supported
0x13,//Incorrect message length or invalid format
0x14,// Response too long
0x21,//Busy Repeat Request
0x22,// Conditions Not Correct
0x24,//Request Sequence Error
0x25,//No Response From Sub – Net Component
0x26,// Failure Prevents Execution Of Requested Action
0x31,//Request Out Of Range
0x33,//Security Access Denied
0x35,// Invalid Key
0x36,// Exceed Number Of Attempts
0x37,// Required Time Delay Not Expired
0x70,// Upload / Download Not Accepted
0x71,//Transfer Data Suspended
0x72,// General Programming Failure
0x78,// Request correctly Received – Response Pending
0x7E// Sub function Not Supported in Active Session
};
int flag;
int session=0;
msTimer timer_session;
byte seed[2]={00,00};
int security_access=0;
}


on message 0x100 //response for tester
{
if(this.byte(1)==0x10)//for diagnostic session A if
{
if(this.byte(0)==0x02)//PCI B if
{
if(this.byte(2)==0x01)//Default session C if
{
flag=1;
response.byte(0)=0x06;
response.byte(3)=time[0];
response.byte(4)=time[1];
response.byte(5)=time[2];
response.byte(6)=time[3];
session=1;

}
else if(this.byte(2)==0x02)//Programming session
{
if(session==1)
{
flag=1; //flag for positive res
setTimer(timer_session,5000);
response.byte(0)=0x06;
response.byte(3)=time[0];
response.byte(4)=time[1];
response.byte(5)=0x13;
response.byte(6)=0x88;
session=2;
}
else
{
flag=NRC[0]; //flag for negative
}
}
else if(this.byte(2)==0x03)//Extended session
{
if(session==2)
{
flag=1; //flag for positive res
setTimer(timer_session,10000);
response.byte(0)=0x06;
response.byte(3)=time[0];
response.byte(4)=time[1];
response.byte(5)=0x27;
response.byte(6)=0x10;
session=3;
}
else
{
flag=NRC[0]; //for negative res
}
}
else //C else
{
flag=NRC[2];
}
}
else //B else
{
flag=NRC[3];
}
}
else if(this.byte(1)==0x3E)// for Tester present
{
if(this.byte(0)==0x02)//PCI
{
if(this.byte(2)==0x00)//Zero subfunction
{
cancelTimer(timer_session);//cancelling timer
flag=1;
response.byte(0)=0x02;
}
else
{
flag=NRC[2];//sub fn not supported
}
}
else
{
flag=NRC[3];//Incorrect PCI
}

}
else if(this.byte(1)==0x27)//Security Access
{
if(session==3)
{
if(this.byte(2)==0x01)//Request seed
{
if(this.byte(0)==0x02)//PCI
{
flag=1;
response.byte(0)=0x04;
response.byte(3)=seed_algo_1();
response.byte(4)=seed_algo_2();
seed[0]=response.byte(3);
seed[1]=response.byte(4);
}
else
{
flag=NRC[3];
}
}
else if(this.byte(2)==0x02)//unlocking with key
{
if(this.byte(0)==0x04)//PCI
{
if(this.byte(3)==key_a_1() && this.byte(4)==key_a_2())//Key checking
{
security_access=1;//enabling the security access
flag=1;
response.byte(0)=0x02;
}
else
{
flag=NRC[12];//Invalid key
}
}
else
{
flag=NRC[3];
}
}
else
{
flag=NRC[2];
}
}
else
{
flag=NRC[6];
}
}


else //A else
{
flag=NRC[1];//Service not supported
}





if(flag==1 || flag==0)//flag to check the positive response with sub fn
{
response.byte(1)=this.byte(1)+pos_res;
if(flag==1)
response.byte(2)=this.byte(2);
output(response);
}
else
{
response.byte(0)=0x03;
response.byte(1)=neg_res;
response.byte(2)=this.byte(1);
response.byte(3)=flag;
output(response);
}

}



on timer timer_session
{
session=1;

}


byte seed_algo_1()
{
return 0x01;
}


byte seed_algo_2()
{
return 0x03;
}
byte key_a_1()
{
if(seed[0]==0x01)
{
return 0x02;
}

return 00;
}
byte key_a_2()
{
if(seed[1]==0x03)
{
return 0x04;
}
return 00;
}